## config/west.yml
```yaml
manifest:
  remotes:
    - name: zmkfirmware
      url-base: https://github.com/zmkfirmware
    - name: beardage 
      url-base: https://github.com/beardage
  projects:
    - name: zmk
      remote: beardage 
      revision: adv360
      import: app/west.yml
  self:
    path: config
```
